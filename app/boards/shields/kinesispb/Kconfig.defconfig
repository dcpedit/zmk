## app/boards/shields/kinesispb/Kconfig.defconfig
```kconfig
# Copyright (c) 2020 The ZMK Contributors
# SPDX-License-Identifier: MIT

if SHIELD_KINESISPB

config ZMK_KEYBOARD_NAME
    default "Kinesis PillBug"

config ZMK_BACKLIGHT
    select LED
    select LED_GPIO

endif
```

## app/boards/shields/kinesispb/Kconfig.shield
```kconfig
# Copyright (c) 2020 The ZMK Contributors
# SPDX-License-Identifier: MIT

config SHIELD_KINESISPB
   def_bool $(shields_list_contains,kinesispb)
```

## app/boards/shields/micro10/Kconfig.shield
```kconfig
# Copyright (c) 2020 The ZMK Contributors
# SPDX-License-Identifier: MIT

config SHIELD_MICRO10
   def_bool $(shields_list_contains,micro10)
```

## app/boards/shields/modmmm/Kconfig.shield
```kconfig
# Copyright (c) 2020 The ZMK Contributors
# SPDX-License-Identifier: MIT

config SHIELD_MODMMM
   def_bool $(shields_list_contains,modmmm)
```
